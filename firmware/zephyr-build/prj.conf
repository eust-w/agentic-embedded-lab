## CMakeLists.txt
```
# SPDX-License-Identifier: Apache-2.0
cmake_minimum_required(VERSION 3.20.0)
find_package(Zephyr REQUIRED HINTS $ENV{ZEPHYR_BASE})
project(ael_build_mechanisms)
target_sources(app PRIVATE src/main.c)
```

## Kconfig
```
# SPDX-License-Identifier: Apache-2.0
mainmenu "AEL Zephyr build mechanism fixtures"

config AEL_DEPENDENCY
    bool "Required feature dependency"

config AEL_FEATURE
    bool "Feature guarded by dependency"
    depends on AEL_DEPENDENCY

config AEL_FORCE_OVERFLOW
    bool "Allocate a deliberately oversized BSS section"

source "Kconfig.zephyr"
```

## prj.conf
```kconfig
CONFIG_MAIN_STACK_SIZE=1024
CONFIG_SERIAL=n
CONFIG_CONSOLE=n
```

## src/main.c
```c
// SPDX-License-Identifier: Apache-2.0
#include <stdint.h>
#include <zephyr/kernel.h>

#if defined(CONFIG_AEL_FEATURE)
const uint32_t ael_feature_marker = 0xa31fea7u;
#endif

#if defined(CONFIG_AEL_FORCE_OVERFLOW)
volatile uint8_t ael_linker_pressure[256 * 1024];
#else
volatile uint8_t ael_linker_pressure[1024];
#endif

int main(void)
{
    /*
     * Keep the linker fixture independent from the devicetree fixture.  The
     * case-2 oracle inspects Zephyr's generated DTS directly, so referencing
     * its synthetic property here would make unrelated cases depend on it.
     */
    ael_linker_pressure[0] = 0;
    return 0;
}
```
